#include QMK_KEYBOARD_H

enum custom_keycodes {
    COPY = SAFE_RANGE,
    ALT_TAB,
    PASTE,
    ALT_F4,
    SEARCH
};

bool is_alt_tab_active = false; 
bool left_tap = false;
uint16_t alt_tab_timer = 0;
char layer_str[11];

const uint16_t PROGMEM keymaps[][MATRIX_ROWS][MATRIX_COLS] = {
    /*
     * ┌───┬───┬───┐
     * │ A │ B │ C │
     * ├───┼───┼───┤
     * │ D │ E │ F │
     * └───┴───┴───┘
     */
    [0] = LAYOUT_ortho_2x3(
        COPY,    PASTE,    TG(1),
        ALT_F4,    SEARCH,    ALT_TAB
    ),
    [1] = LAYOUT_ortho_2x3(
        COPY,    KC_UP,   TG(1),
        KC_LEFT,    KC_DOWN,    KC_RIGHT
    )
};

#ifdef OLED_ENABLE
static void render_cat(void) {
    static const char PROGMEM tap1[] = {
        0x00, 0x00, 0x00, 0x00, 0x00, 0x00, 0x00, 0x00, 0x00, 0x00, 0x00, 0x00, 0x00, 0x00, 0x00, 0x00, 0x00, 0x00, 0x00, 0x00, 0x00, 
        0x00, 0x00, 0x00, 0x00, 0x00, 0x00, 0x00, 0x00, 0x00, 0x00, 0x00, 0x00, 0x00, 0x00, 0x00, 0x00, 0x00, 0x00, 0x00, 0x00, 0x00, 
        0x00, 0x00, 0x00, 0x00, 0x00, 0x00, 0x00, 0x00, 0x00, 0x00, 0x00, 0x00, 0x00, 0x00, 0x00, 0x00, 0x00, 0x00, 0x00, 0x00, 0x00, 
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        0x00, 0x00, 0x00, 0x00, 0x00, 0x00, 0x00, 0x00
    };

    static const char PROGMEM tap2[] = {
        0x00, 0x00, 0x00, 0x00, 0x00, 0x00, 0x00, 0x00, 0x00, 0x00, 0x00, 0x00, 0x00, 0x00, 0x00, 0x00, 0x00, 0x00, 0x00, 0x00, 0x00, 
        0x00, 0x00, 0x00, 0x00, 0x00, 0x00, 0x00, 0x00, 0x00, 0x00, 0x00, 0x00, 0x00, 0x00, 0x00, 0x00, 0x00, 0x00, 0x00, 0x00, 0x00, 
        0x00, 0x00, 0x00, 0x00, 0x00, 0x00, 0x00, 0x00, 0x00, 0x00, 0x00, 0x00, 0x00, 0x00, 0x00, 0x00, 0x00, 0x00, 0x00, 0x00, 0x00, 
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        0x00, 0x00, 0x00, 0x00, 0x00, 0x00, 0x00, 0x00
    };
    
    if(left_tap) {
        oled_write_raw_P(tap1, 512);
    }
    if(!left_tap) {
        oled_write_raw_P(tap2, 512);
    }
}

bool oled_task_user(void) {
    render_cat();
    return false;
}

#endif


bool process_record_user(uint16_t keycode, keyrecord_t *record) {
    switch(keycode) {
        case COPY: 
            if(record->event.pressed) {
                SEND_STRING(SS_LCTL("c"));
            }
            change_tap();
            break;
        case PASTE:
            if(record->event.pressed) {
                SEND_STRING(SS_LCTL("v"));
            }
            change_tap();
            break;
        case ALT_TAB:
            if (record->event.pressed) {
                if (!is_alt_tab_active) {
                is_alt_tab_active = true;
                register_code(KC_LALT);
                }
                alt_tab_timer = timer_read();
                register_code(KC_TAB);
            } 
            else {
                unregister_code(KC_TAB);
            }
            change_tap();
            break;
        case ALT_F4:
            if(record->event.pressed) {
                SEND_STRING(SS_LALT(SS_TAP(X_F4)));
            }
            change_tap();
            break;
        case SEARCH:
            if(record->event.pressed) {
                SEND_STRING(SS_LWIN("q"));
            }
            change_tap();
            break;
        default:
            change_tap();
            break;
    }
    return true;
}

void matrix_scan_user(void) { 
    if (is_alt_tab_active) {
        if (timer_elapsed(alt_tab_timer) > 1000) {
        unregister_code(KC_LALT);
        is_alt_tab_active = false;
        }
    }
}


void change_tap(void) {
    if(left_tap) {
        left_tap = false;
        return;
    }
    if(!left_tap) {
        left_tap = true;
        return;
    }
}